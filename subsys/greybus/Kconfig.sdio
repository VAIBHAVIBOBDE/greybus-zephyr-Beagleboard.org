## subsys/greybus/Kconfig.sdio
```kconfig
# Copyright (c) 2024 BeagleBoard.org
# SPDX-License-Identifier: BSD-3-Clause

menuconfig GREYBUS_SDIO
	bool "Greybus SDIO Protocol"
	depends on GREYBUS
	help
	  Enable Greybus SDIO protocol support.

if GREYBUS_SDIO

config GREYBUS_SDIO_CONTROLLER_NAME
	string "SDHC Controller Device Name"
	default "SDHC_0"
	help
	  The device name of the SDHC controller to use for Greybus SDIO.

endif # GREYBUS_SDIO
```

## tests/greybus/integration/sdio/testcase.yaml
```yaml
common:
  tags: greybus sdio
tests:
  greybus.integration.sdio:
    platform_allow:
      - beagleconnect_freedom
      - native_sim
    integration_platforms:
      - beagleconnect_freedom
      - native_sim
```
