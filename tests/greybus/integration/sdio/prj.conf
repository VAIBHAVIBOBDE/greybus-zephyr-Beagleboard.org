## CMakeLists.txt
```
# SPDX-License-Identifier: Apache-2.0

cmake_minimum_required(VERSION 3.20.0)
find_package(Zephyr REQUIRED HINTS $ENV{ZEPHYR_BASE})
project(greybus_sdio_test)

target_sources(app PRIVATE src/main.c)

# GREYBUS_SDIO requires generic GREYBUS support
target_include_directories(app PRIVATE ${ZEPHYR_BASE}/include)

if("${BOARD}" STREQUAL "native_sim")
  target_sources(app PRIVATE src/sdhc_stub.c)
  list(APPEND DTS_ROOT ${CMAKE_CURRENT_SOURCE_DIR}/dts)
endif()
```

## prj.conf
```kconfig
CONFIG_ZTEST=y
CONFIG_GREYBUS=y
CONFIG_GREYBUS_SDIO=y
CONFIG_SDHC=y
CONFIG_MAIN_STACK_SIZE=2048
```

## boards/native_sim.conf
```kconfig
CONFIG_SDHC=y
CONFIG_GREYBUS_SDIO_CONTROLLER_NAME="SDHC_0"
```

## boards/native_sim.overlay
```dts
/ {
	sdhc0: sdhc0 {
		compatible = "test,sdhc-stub";
		status = "okay";
		max-bus-freq = <200000000>;
		min-bus-freq = <400000>;
		bus-width = <4>;
	};
};
```

## dts/bindings/test,sdhc-stub.yaml
```yaml
description: Test SDHC Stub Driver

compatible: "test,sdhc-stub"

include: base.yaml

properties:
  max-bus-freq:
    type: int
    required: true
    description: Maximum bus frequency
  min-bus-freq:
    type: int
    required: true
    description: Minimum bus frequency
  bus-width:
    type: int
    required: true
    description: Bus width
```

## src/main.c
```c
/*
 * Copyright (c) 2024 BeagleBoard.org
 * SPDX-License-Identifier: BSD-3-Clause
 */

#include "greybus/greybus_messages.h"
#include <zephyr/ztest.h>
#include <greybus/greybus.h>
#include <zephyr/drivers/sdhc.h>

/* Mock specific setup if needed, or rely on real hardware */

struct gb_msg_with_cport gb_transport_get_message(void);

ZTEST_SUITE(greybus_sdio_tests, NULL, NULL, NULL, NULL, NULL);

/* Helper to normalize retrieving the response */
static struct gb_msg_with_cport get_response_checked(uint8_t type, uint16_t min_payload_len)
{
	struct gb_msg_with_cport msg = gb_transport_get_message();

	zassert(gb_message_is_success(msg.msg), "Request failed");
	zassert_equal(gb_message_type(msg.msg), type, "Invalid response type");
	zassert_true(gb_message_payload_len(msg.msg) >= min_payload_len, "Payload too small");

	return msg;
}

ZTEST(greybus_sdio_tests, test_protocol_version)
{
	struct gb_msg_with_cport resp;
	const struct gb_sdio_proto_version_response *resp_data;
	struct gb_message *msg = gb_message_request_alloc(0, GB_SDIO_TYPE_PROTOCOL_VERSION, false);

	/* Send to CPort 0 (or whatever CPort SDIO is bound to in manifest, assuming 0/1 for test setup) */
	/* Note: In integration tests, we manually inject the message into the handler */
	greybus_rx_handler(1, msg); 
	
	resp = get_response_checked(GB_RESPONSE(GB_SDIO_TYPE_PROTOCOL_VERSION), sizeof(*resp_data));
	resp_data = (const struct gb_sdio_proto_version_response *)resp.msg->payload;

	zassert_equal(resp_data->major, 0, "Invalid Major Version");
	zassert_equal(resp_data->minor, 1, "Invalid Minor Version");

	gb_message_dealloc(resp.msg);
}

ZTEST(greybus_sdio_tests, test_get_capabilities)
{
	struct gb_msg_with_cport resp;
	const struct gb_sdio_get_caps_response *resp_data;
	struct gb_message *msg = gb_message_request_alloc(0, GB_SDIO_TYPE_GET_CAPABILITIES, false);

	greybus_rx_handler(1, msg);
	
	resp = get_response_checked(GB_RESPONSE(GB_SDIO_TYPE_GET_CAPABILITIES), sizeof(*resp_data));
	resp_data = (const struct gb_sdio_get_caps_response *)resp.msg->payload;

	/* Verify some basic caps - dependent on what sdhc_get_host_props returns */
	/* We check if caps are non-zero/reasonable */
	
	/* Just ensure we got a valid response structure back */
	zassert_true(resp_data->max_blk_size > 0, "Max block size should be > 0");

	gb_message_dealloc(resp.msg);
}
```

## src/sdhc_stub.c
```c
/*
 * Copyright (c) 2024 BeagleBoard.org
 * SPDX-License-Identifier: BSD-3-Clause
 */

#define DT_DRV_COMPAT test_sdhc_stub

#include <zephyr/kernel.h>
#include <zephyr/device.h>
#include <zephyr/drivers/sdhc.h>
#include <zephyr/logging/log.h>

LOG_MODULE_REGISTER(sdhc_stub, CONFIG_SDHC_LOG_LEVEL);

struct sdhc_stub_config {
    struct sdhc_host_props props;
};

static int sdhc_stub_reset(const struct device *dev)
{
    return 0;
}

static int sdhc_stub_request(const struct device *dev,
                             struct sdhc_command *cmd,
                             struct sdhc_data *data)
{
    /* Mock successful responses */
    cmd->response[0] = 0x00000900; /* Ready for data */
    cmd->response[1] = 0;
    cmd->response[2] = 0;
    cmd->response[3] = 0;
    
    return 0;
}

static int sdhc_stub_set_io(const struct device *dev, struct sdhc_io *ios)
{
    return 0;
}

static int sdhc_stub_get_card_present(const struct device *dev)
{
    return 1;
}

static int sdhc_stub_get_host_props(const struct device *dev,
                                    struct sdhc_host_props *props)
{
    const struct sdhc_stub_config *config = dev->config;

    *props = config->props;
    return 0;
}

static DEVICE_API(sdhc, sdhc_stub_api) = {
    .reset = sdhc_stub_reset,
    .request = sdhc_stub_request,
    .set_io = sdhc_stub_set_io,
    .get_card_present = sdhc_stub_get_card_present,
    .get_host_props = sdhc_stub_get_host_props,
};

#define SDHC_STUB_INIT(n)                                                      \
    static const struct sdhc_stub_config sdhc_stub_config_##n = {              \
        .props = {                                                             \
            .f_max = DT_INST_PROP(n, max_bus_freq),                            \
            .f_min = DT_INST_PROP(n, min_bus_freq),                            \
            .power_delay = 0,                                                  \
            .host_caps = {                                                     \
                .vol_180_support = 1,                                          \
                .vol_300_support = 1,                                          \
                .vol_330_support = 1,                                          \
                .suspend_res_support = 0,                                      \
                .sdma_support = 0,                                             \
                .high_speed_support = 1,                                       \
                .adma_2_support = 0,                                           \
                .uahs_support = 0,                                             \
                .bus_8_bit_support = 1,                                        \
                .bus_4_bit_support = 1,                                        \
                .sdr104_support = 0,                                           \
                .sdr50_support = 0,                                            \
                .ddr50_support = 0,                                            \
                .slot_type = 0,                                                \
            },                                                                 \
            .max_current_330 = 200,                                            \
            .max_current_300 = 200,                                            \
            .max_current_180 = 200,                                            \
        },                                                                     \
    };                                                                         \
                                                                               \
    DEVICE_DT_INST_DEFINE(n, NULL, NULL, NULL,                                 \
                          &sdhc_stub_config_##n, POST_KERNEL,                  \
                          CONFIG_SDHC_INIT_PRIORITY, &sdhc_stub_api);

DT_INST_FOREACH_STATUS_OKAY(SDHC_STUB_INIT)
```
